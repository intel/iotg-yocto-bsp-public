## meta-intel-leafhill/conf/layer.conf
```bitbake
# We have a conf and classes directory, add to BBPATH
BBPATH .= ":${LAYERDIR}"

# We have recipes-* directories, add to BBFILES
BBFILES += "${LAYERDIR}/recipes-*/*/*.bb \
            ${LAYERDIR}/recipes-*/*/*.bbappend"

BBFILE_COLLECTIONS += "leafhill"
BBFILE_PATTERN_leafhill = "^${LAYERDIR}/"
BBFILE_PRIORITY_leafhill = "7"

# Defining dependencies of this layer
LAYERDEPENDS_leafhill = "intel"
```

## meta-intel-leafhill/wic/systemd-bootdisk-microcode-custom-rt.wks
```
# short-description: Create an EFI disk image with systemd-boot
# long-description: Creates a partitioned EFI disk image that the user
# can directly dd to boot media. The selected bootloader is systemd-boot.
# It also includes intel-microcode as an initrd for early update support.
# Based on OE-core's systemd-bootdisk.wks file.

part /boot --source bootimg-efi --sourceparams="loader=systemd-boot,initrd=microcode.cpio" --ondisk sda --label msdos --active --align 1024 --use-uuid

part / --source rootfs --ondisk sda --fstype=ext4 --label platform --align 1024 --use-uuid

part swap --ondisk sda --size 44 --label swap1 --fstype=swap --use-uuid

bootloader --ptable gpt --timeout=5 --append="console=ttyS2,115200n8 rootwait snd_hda_intel.power_save=1 snd_hda_intel.power_save_controller=y scsi_mod.scan=async i915.enable_guc_loading=1 processor.max_cstate=0 intel_idle.max_cstate=0 clocksource=tsc tsc=reliable nmi_watchdog=0 nosoftlockup intel_pstate=disable idle=poll noht"
```

## meta-intel-middleware/conf/distro/include/meta_intel_middleware-python3.inc
```bitbake
PYTHON_BASEVERSION_pn-mplayer2 = "3.5"
PYTHON_BASEVERSION_pn-python3-cython = "3.5"
PYTHON_BASEVERSION_pn-python3-cython-native = "3.5"
PYTHON_BASEVERSION_pn-python3-decorator = "3.5"
PYTHON_BASEVERSION_pn-python3-lxml = "3.5"
PYTHON_BASEVERSION_pn-python3-lxml-native = "3.5"
PYTHON_BASEVERSION_pn-python3-jsonschema = "3.5"
PYTHON_BASEVERSION_pn-python3-jsonschema-native = "3.5"
PYTHON_BASEVERSION_pn-python3-pip = "3.5"
PYTHON_BASEVERSION_pn-python3-pyinotify = "3.5"
PYTHON_BASEVERSION_pn-python3-pyserial = "3.5"
PYTHON_BASEVERSION_pn-python3-setuptools = "3.5"
PYTHON_BASEVERSION_pn-python3-setuptools-native = "3.5"
PYTHON_BASEVERSION_pn-soletta = "3.5"
```

## meta-intel-middleware/conf/distro/include/meta_intel_middleware-security_flags.inc
```bitbake
# Setup extra CFLAGS and LDFLAGS which have 'security' benefits.
# Some of these packages don't belong to this layer. However,
# keeping them here to ensure everything compiles. These
# should be removed when they've been fixed upstream.

SECURITY_CFLAGS_pn-mraa = "${SECURITY_NO_PIE_CFLAGS}"
SECURITY_CFLAGS_pn-libproxy = "${SECURITY_NO_PIE_CFLAGS}"
SECURITY_CFLAGS_pn-gcc-sanitizers = "${SECURITY_NO_PIE_CFLAGS}"

# Deal with linker failures when using the cflags
SECURITY_CFLAGS_pn-graphviz = ""

SECURITY_CFLAGS_pn-at-spi2-core = "${SECURITY_NO_PIE_CFLAGS}"
SECURITY_CFLAGS_pn-at-spi2-atk = "${SECURITY_NO_PIE_CFLAGS}"
SECURITY_CFLAGS_pn-freetype = "${SECURITY_NO_PIE_CFLAGS}"
SECURITY_CFLAGS_pn-glib-2.0 = "${SECURITY_NO_PIE_CFLAGS}"
SECURITY_CFLAGS_pn-glib-networking = "${SECURITY_NO_PIE_CFLAGS}"
SECURITY_CFLAGS_pn-gobject-introspection = "${SECURITY_NO_PIE_CFLAGS}"
SECURITY_CFLAGS_pn-libepoxy = "${SECURITY_NO_PIE_CFLAGS}"
SECURITY_CFLAGS_pn-pango = "${SECURITY_NO_PIE_CFLAGS}"
SECURITY_CFLAGS_pn-gdk-pixbuf = "${SECURITY_NO_PIE_CFLAGS}"
SECURITY_CFLAGS_pn-libinput = "${SECURITY_NO_PIE_CFLAGS}"
SECURITY_CFLAGS_pn-libmodulemd = "${SECURITY_NO_PIE_CFLAGS}"
SECURITY_CFLAGS_pn-libsoup-2.4 = "${SECURITY_NO_PIE_CFLAGS}"
SECURITY_CFLAGS_pn-systemd = "${SECURITY_NO_PIE_CFLAGS}"
SECURITY_CFLAGS_pn-sysprof = "${SECURITY_NO_PIE_CFLAGS}"

SECURITY_CFLAGS_pn-json-glib = "${SECURITY_PIE_CFLAGS}"
SECURITY_CFLAGS_pn-gstreamer1.0 = "${SECURITY_PIE_CFLAGS}"
SECURITY_CFLAGS_pn-gstreamer1.0-plugins-base = "${SECURITY_PIE_CFLAGS}"
SECURITY_CFLAGS_pn-gstreamer1.0-plugins-bad = "${SECURITY_PIE_CFLAGS}"
SECURITY_CFLAGS_pn-gstreamer1.0-plugins-ugly = "${SECURITY_PIE_CFLAGS}"
SECURITY_CFLAGS_pn-gstreamer1.0-plugins-good = "${SECURITY_PIE_CFLAGS}"
SECURITY_CFLAGS_pn_gstreamer1.0-rtsp-server = "${SECURITY_PIE_CFLAGS}"
SECURITY_CFLAGS_pn-gstreamer1.0-libav = "${SECURITY_PIE_CFLAGS}"
```

## meta-intel-middleware/conf/layer.conf
```bitbake
# We have a conf and classes directory, add to BBPATH
BBPATH .= ":${LAYERDIR}"

# We have recipes-* directories, add to BBFILES
BBFILES += "${LAYERDIR}/recipes-*/*/*.bb \
	    ${LAYERDIR}/recipes-*/*/*.bbappend"

BBFILE_COLLECTIONS += "iotg"
BBFILE_PATTERN_iotg = "^${LAYERDIR}/"
BBFILE_PRIORITY_iotg = "8"

require conf/distro/include/meta_intel_middleware-security_flags.inc
require conf/distro/include/meta_intel_middleware-python3.inc
```

## meta-intel-tsn/conf/layer.conf
```bitbake
# We have a conf and classes directory, add to BBPATH
BBPATH .= ":${LAYERDIR}"

# We have recipes-* directories, add to BBFILES
BBFILES += "${LAYERDIR}/recipes-*/*/*.bb \
            ${LAYERDIR}/recipes-*/*/*.bbappend"

BBFILE_COLLECTIONS += "intel-tsn"
BBFILE_PATTERN_intel-tsn := "^${LAYERDIR}/"
BBFILE_PRIORITY_intel-tsn = "6"

LAYERSERIES_COMPAT_intel-tsn = "sumo"
```
